## config/boards/shields/lily58_enc/Kconfig.shield
```kconfig
# Copyright (c) 2020 Pete Johanson
# SPDX-License-Identifier: MIT

config SHIELD_LILY58_ENC_LEFT
	def_bool $(shields_list_contains,lily58_enc_left)

config SHIELD_LILY58_ENC_RIGHT
	def_bool $(shields_list_contains,lily58_enc_right)
```
