
/*****************************************
 * Encoder definitions
 *****************************************/
/ {
    left_encoder: encoder_left {
            compatible = "alps,ec11";
            label = "LEFT_ENCODER";
            a-gpios = <19 (GPIO_ACTIVE_HIGH | GPIO_PULL_UP)>;
            b-gpios = <6 (GPIO_ACTIVE_HIGH | GPIO_PULL_UP)>;
            resolution = <4>;
            status = "disabled";
        };


    right_encoder: encoder_right {
            compatible = "alps,ec11";
            label = "RIGHT_ENCODER";
            a-gpios = <19 (GPIO_ACTIVE_HIGH | GPIO_PULL_UP)>;
            b-gpios = <6 (GPIO_ACTIVE_HIGH | GPIO_PULL_UP)>;
            resolution = <4>;
            status = "disabled";
        };

	sensors {
		compatible = "zmk,keymap-sensors";
		sensors = <&left_encoder &right_encoder>;
	};
}